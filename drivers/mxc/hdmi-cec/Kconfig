## drivers/mxc/hdmi-cec/Kconfig
```kconfig
menu "MXC HDMI CEC (Consumer Electronics Control) support"

config MXC_HDMI_CEC
	tristate "Support for MXC HDMI CEC (Customised driver, SR driver available if deselected)"
	depends on MFD_MXC_HDMI
	depends on FB_MXC_HDMI || DRM_IMX_HDMI
	help
	  The HDMI CEC device implement low level protocol on i.MX6x platforms.

config MXC_HDMI_CEC_SR
	tristate "Support for MXC HDMI CEC (Upstream tree SR driver)"
	depends on MFD_MXC_HDMI
	depends on FB_MXC_HDMI
	depends on MXC_HDMI_CEC=n
	help
	  The HDMI CEC device implement low level protocol on i.MX6x platforms.

endmenu
```

## drivers/video/mxc/Kconfig
```kconfig
config FB_MXC
	tristate "MXC Framebuffer support"
	depends on FB
	select FB_CFB_FILLRECT
	select FB_CFB_COPYAREA
	select FB_CFB_IMAGEBLIT
	select FB_MODE_HELPERS
	default y
	help
	  This is a framebuffer device for the MXC LCD Controller.
	  See <http://www.linux-fbdev.org/> for information on framebuffer
	  devices.

	  If you plan to use the LCD display with your MXC system, say
	  Y here.

config FB_MXC_SYNC_PANEL
	depends on FB_MXC
	tristate "Synchronous Panel Framebuffer"

config FB_MXC_TVOUT_ADV739X
	tristate "ADV7390/7391 TV Out Encoder"
	depends on FB_MXC_SYNC_PANEL && I2C

config FB_MXC_LDB
	tristate "MXC LDB"
	depends on FB_MXC_SYNC_PANEL
	depends on MXC_IPU_V3_FSL || IMX_IPUV3_CORE
	select VIDEOMODE_HELPERS

config FB_MXC_MIPI_DSI
	tristate "MXC MIPI_DSI"
	depends on FB_MXC_SYNC_PANEL
	depends on MXC_IPU_V3_FSL || IMX_IPUV3_CORE

config FB_MXC_TRULY_WVGA_SYNC_PANEL
	tristate "TRULY WVGA Panel"
	depends on FB_MXC_SYNC_PANEL
	depends on FB_MXC_MIPI_DSI

config FB_MXC_HDMI
	depends on FB_MXC_SYNC_PANEL
	depends on MXC_IPU_V3_FSL || IMX_IPUV3_CORE
	depends on I2C
	tristate "MXC HDMI driver support"
	select MFD_MXC_HDMI
	select HDMI
	help
	  Driver for the on-chip MXC HDMI controller.

config FB_MXC_DCIC
        tristate "MXC DCIC"
        depends on FB_MXC_SYNC_PANEL
        depends on MXC_IPU_V3_FSL || FB_MXS
        select VIDEOMODE_HELPERS

config FB_MXC_EDID
     depends on FB_MXC && I2C && DRM
     tristate "MXC EDID support"
     default y

config FB_MXC_EINK_PANEL
	depends on FB_MXC
	depends on DMA_ENGINE
	select FB_DEFERRED_IO
	tristate "E-Ink Panel Framebuffer"

config FB_MXC_EINK_AUTO_UPDATE_MODE
	bool "E-Ink Auto-update Mode Support"
	default n
	depends on FB_MXC_EINK_PANEL
```
